## zmk-workspace/build_left/Kconfig/Kconfig.shield.defconfig
```kconfig
osource "/zmk-workspace/zmk/app/module/boards/shields/*/Kconfig.defconfig"
osource "/zmk-workspace/zmk/app/boards/shields/*/Kconfig.defconfig"
osource "/zmk-workspace/config/boards/shields/*/Kconfig.defconfig"
```

## zmk-workspace/build_left/Kconfig/boards/Kconfig
```kconfig
# Load Zephyr board Kconfig descriptions.
osource "/zmk-workspace/zmk/app/module/boards/nicekeyboards/nice_nano/Kconfig"
osource "/zmk-workspace/zmk/app/boards/nicekeyboards/nice_nano/Kconfig"
```

## zmk-workspace/build_left/Kconfig/boards/Kconfig.defconfig
```kconfig
# Load Zephyr board defconfig descriptions.
osource "/zmk-workspace/zmk/app/module/boards/nicekeyboards/nice_nano/Kconfig.defconfig"
osource "/zmk-workspace/zmk/app/boards/nicekeyboards/nice_nano/Kconfig.defconfig"
```

## zmk-workspace/build_left/Kconfig/boards/Kconfig.nice_nano
```kconfig
# Load board Kconfig descriptions.
osource "/zmk-workspace/zmk/app/module/boards/nicekeyboards/nice_nano/Kconfig.nice_nano"
osource "/zmk-workspace/zmk/app/boards/nicekeyboards/nice_nano/Kconfig.nice_nano"
```

## zmk-workspace/build_left/Kconfig/boards/Kconfig.sysbuild
```kconfig
# Load Sysbuild board Kconfig descriptions.
osource "/zmk-workspace/zmk/app/module/boards/nicekeyboards/nice_nano/Kconfig.sysbuild"
osource "/zmk-workspace/zmk/app/boards/nicekeyboards/nice_nano/Kconfig.sysbuild"
```

## zmk-workspace/build_right/Kconfig/Kconfig.shield
```kconfig
osource "/zmk-workspace/zmk/app/module/boards/shields/*/Kconfig.shield"
osource "/zmk-workspace/zmk/app/boards/shields/*/Kconfig.shield"
osource "/zmk-workspace/config/boards/shields/*/Kconfig.shield"
```

## zmk-workspace/build_right/Kconfig/arch/Kconfig
```kconfig
# Load Zephyr Arch Kconfig descriptions.
osource "/zmk-workspace/zephyr/arch/x86/Kconfig"
osource "/zmk-workspace/zephyr/arch/xtensa/Kconfig"
osource "/zmk-workspace/zephyr/arch/sparc/Kconfig"
osource "/zmk-workspace/zephyr/arch/riscv/Kconfig"
osource "/zmk-workspace/zephyr/arch/posix/Kconfig"
osource "/zmk-workspace/zephyr/arch/nios2/Kconfig"
osource "/zmk-workspace/zephyr/arch/mips/Kconfig"
osource "/zmk-workspace/zephyr/arch/arm64/Kconfig"
osource "/zmk-workspace/zephyr/arch/arm/Kconfig"
osource "/zmk-workspace/zephyr/arch/arc/Kconfig"
```
